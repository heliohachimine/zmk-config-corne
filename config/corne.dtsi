/ {
    key-matrix {
        compatible = "zmk,matrix-transform";
        row-count = <4>;
        col-count = <6>;
        col-split = <3>;
    };

    &matrix {
        row-gpios = <&gpio0 24 GPIO_ACTIVE_HIGH>,  // D3
                    <&gpio0 22 GPIO_ACTIVE_HIGH>,  // D2
                    <&gpio0 20 GPIO_ACTIVE_HIGH>,  // D1
                    <&gpio0 17 GPIO_ACTIVE_HIGH>;  // D0

        col-gpios = <&gpio0 11 GPIO_ACTIVE_LOW>,  // Tente com ACTIVE_LOW
                    <&gpio0 10 GPIO_ACTIVE_LOW>,
                    <&gpio0 8  GPIO_ACTIVE_LOW>,
                    <&gpio0 6  GPIO_ACTIVE_LOW>,
                    <&gpio1 9 GPIO_ACTIVE_LOW>,
                    <&gpio1 13 GPIO_ACTIVE_LOW>;
    };
};
